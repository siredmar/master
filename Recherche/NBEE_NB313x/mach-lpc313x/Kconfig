## Recherche/NBEE_NB313x/mach-lpc313x/Kconfig
```kconfig
menu "LPC313x Implementations"
	depends on ARCH_LPC313X

choice
	prompt "LPC313x Platform type"
	default MACH_EA313X

config MACH_FHS3143
  bool "fhs3143 board"
  help
     Say Y here if you are using the FHS3143

config MACH_NB31
  bool "nb31xx board"
  help
     Say Y here if you are using NBEE Embedded Systems's NB31XX board series.

config MACH_EA313X
	bool "ea313x board"
	help
	  Say Y here if you are using the Embedded Artist's EA313x board

config MACH_VAL3153
	bool "val3153 board"
	help
	  Say Y here if you are using the NXP val3153 board

config MACH_VAL3154
	bool "val3154 board"
	select LPC3152_AD
	help
	  Say Y here if you are using the NXP val3154 board
	  
endchoice

config NB31_ENABLETOUCH
	bool "touch screen enabled"
	help
	Say Y here if you want to use the touchscreen controller on SPI CS1

config LPC3152_AD
	bool

source "kernel/Kconfig.hz"

endmenu
```

## Teil A/software/bootloader/apex-1.6.8-vanilla-broken/src/mach-ixp42x/Kconfig
```kconfig
if ARCH_IXP42X

choice
	prompt "IXP42X Implementations"
	default MACH_NSLU2

config MACH_NSLU2
	bool "Linksys NSLU2"
	select ARCH_IXP420
	select USES_NOR_CFI
	select USES_NOR_BOOTFLASH
	select USES_IXP4XX_NPE_ETH
	select INLINE_PLATFORM_INITIALIZATION
	select INLINE_PLATFORM_INITIALIZATION_SDRAM_PRE_OVERRIDE

config MACH_NAS100D
	bool "Iomega NAS100D"
	select ARCH_IXP420
	select USES_NOR_CFI
	select USES_NOR_BOOTFLASH
	select INLINE_PLATFORM_INITIALIZATION
	select INLINE_PLATFORM_INITIALIZATION_SDRAM_PRE_OVERRIDE

config MACH_DSMG600
	bool "D-Link DSM-G600 RevA"
	select ARCH_IXP420
	select USES_NOR_CFI
	select USES_NOR_BOOTFLASH
	select INLINE_PLATFORM_INITIALIZATION
	select INLINE_PLATFORM_INITIALIZATION_SDRAM_PRE_OVERRIDE

config MACH_FSG3
	bool "Freecom FSG-3"
	select ARCH_IXP420
	select USES_NOR_CFI
	select USES_NOR_BOOTFLASH
	select INLINE_PLATFORM_INITIALIZATION
	select INLINE_PLATFORM_INITIALIZATION_SDRAM_PRE_OVERRIDE

config MACH_AVILA2347
	bool "Gateworks Avila 2347"
	select ARCH_IXP422
	select MACH_AVILA
	select USES_NOR_CFI
	select USES_NOR_BOOTFLASH
	select INLINE_PLATFORM_INITIALIZATION
	select INLINE_PLATFORM_INITIALIZATION_SDRAM_PRE_OVERRIDE

endchoice

choice
	prompt "CPU endian-ness"
	default USER_BIGENDIAN

config USER_DEFAULTENDIAN
	bool "Default Endian-ness"
	help
	  Use the endian-ness as set by the CPU on reset, or by the
	  first stage boot loader when APEX is the second stage.

config USER_BIGENDIAN
	bool "Big-Endian"
	select BIGENDIAN
	help
	  The endian-ness of the CPU is selectable at runtime.  Intel
	  has traditionally configured their XScale CPUs to use
	  big-ending byte ordering.  However, the real determinant of
	  the endian-ness is the runtime libraries and operating
	  system components.

	  Until version 1.5 of the Intel Access Library, only
	  big-endian mode was supported for the NPE (Network
	  Processing Element).  If you depend on the built-in MAC,
	  you'll probably continue to use big-endian mode.  If you use
	  an external ethernet device, e.g. USB, or if someone
	  successfully integrates the version 1.5 library into the
	  Linux kernel, you may be able to use little-endian mode.

config USER_LITTLEENDIAN
	bool "Little-Endian"
	select LITTLEENDIAN
	help
	  The endian-ness of the CPU is selectable at runtime.  Intel
	  has traditionally configured their XScale CPUs to use
	  big-ending byte ordering.

	  The CPU will default to little-endian mode, so this option
	  is usually not needed.  However, if APEX is a second-stage
	  loader and the first stage sets the CPU in big-endian mode
	  then this option is necessary to put the CPU back into
	  little-endian mode.

endchoice

menu "Platform Setup"

config ATAG_PHYS
	hex "Physical address for ATAGs list"
	default "0x00000100"
	depends on ATAG
	help
	  This is the address where APEX will construct the ATAG list
	  before starting the Linux kernel.  This address should be
	  within the first 16KiB of physical RAM.  Don't change this
	  value unless you know what you are doing. 

config ARCH_NUMBER
	int
	default 597 if MACH_NSLU2
	default 865 if MACH_NAS100D
	default 964 if MACH_DSMG600
	default 1091 if MACH_FSG3

config APEX_VMA
	hex "APEX runtime address"
	default "0x00200000"

config KERNEL_LMA
	hex "Kernel load address"
	default "0x00008000"

config USE_RAMDISK
	bool "Enable ramdisk options"
	help
	  This option doesn't enable the ramdisk, per se.  It enables
	  other configuration options that help setup a default
	  ramdisk.  The kernel command line and the APEX startup
	  commands may be overridden to perform the same steps.

	  There is a separate option in the Environment section that
	  controls whether or not APEX copies the ramdisk from flash
	  into RAM at startup.  That is where the ramdisk region is
	  defined.

config RAMDISK_LMA
	hex "Ramdisk load address"
	default "0x01000000"
	depends on USE_RAMDISK

config RAMDISK_SIZE
	hex "Ramdisk size"
	default "0x00400000"
	depends on USE_RAMDISK

config SDRAM_BANK0
	bool "Enable SDRAM bank 0"
	default y

config SDRAM_BANK1
	bool "Enable SDRAM bank 1"
	depends on SDRAM_BANK0

config SDRAM_BANK_LENGTH
	hex "Size, in bytes, of each SDRAM bank"
	default 0x02000000

config NOR_BUSWIDTH
	int "Width of NOR flash bus"
	default "16"
	
config NOR_BANK0
	bool "Enable NOR flash bank 0"
	default y

config NOR_BANK0_START
	hex "Physical address of NOR flash bank 0"
	default "0x50000000"
	depends on NOR_BANK0

config NOR_BANK0_LENGTH
	hex "Size, in bytes, of NOR flash bank 0"
	default "0x00800000" if MACH_NSLU2
	depends on NOR_BANK0

config DISABLE_SECOND_UART_INIT
	bool "Disable initialization of second UART"
	help
	  The Linux kernel serial driver for the IXP42x doesn't enable
	  the UARTs.  This option prevents the secondary UART from be
	  enabled and, therefore, preventing it from being used by the
	  kernel.  In other words, setting this option to Y will
	  prevent Linux from using the second UART.

	  Best to leave this option as 'N' unless you have a good
	  reason to change it.

endmenu

config MACH
	string
	default "ixp42x"

config ARCH_IXP420
	bool
	select CPU_ARMV5
	select CPU_XSCALE

config ARCH_IXP422
	bool
	select CPU_ARMV5
	select CPU_XSCALE

config ARCH_IXP425
	bool
	select CPU_ARMV5
	select CPU_XSCALE

config MACH_AVILA
	bool
	select CPU_ARMV5
	select CPU_XSCALE

endif
```

## Teil A/software/linux/gnublin-lpc3131-3.3.0-master/linux-3.3.0-lpc313x/arch/arm/mach-lpc31xx/Kconfig
```kconfig
menu "LPC313x Implementations"
	depends on ARCH_LPC31XX

choice
	prompt "LPC313x Platform type"
	default MACH_EA313X

config MACH_EA313X
	bool "ea313x board"
	help
	  Say Y here if you are using the Embedded Artist's EA313x board

config MACH_GNUBLIN
	bool "gnublin board"
	help
	  Say Y here if you are using the Embedded Gnublin Board

config MACH_EA3152
	bool "ea3152 board"
	select LPC3152_AD
	help
	  Say Y here if you are using Embedded Artist's EA3152 board
	  
config MACH_VAL3153
	bool "val3153 board"
	help
	  Say Y here if you are using the NXP val3153 board

config MACH_VAL3154
	bool "val3154 board"
	select LPC3152_AD
	help
	  Say Y here if you are using the NXP val3154 board
	  
endchoice

config LPC3152_AD
	bool

source "kernel/Kconfig.hz"

endmenu




menu "Special settings"
	depends on ARCH_LPC31XX


config DUAL_MODE
	bool "Add a second SPI device"
	help
	   If you want to connect 2 SPI devices to GNUBLIN, then its required 
	   to have 2 chip selects.
	   This option will set a second chipselect.
	   (Chip select 0 -->GPIO_15)
	   (Chip select 1 -->GPIO_11)

config CS_TO_IO11
	bool "Use GPIO11 as SPI chip select"
	depends on !DUAL_MODE
	help
	   This option will set the CS_OUT0 Pin to GPIO11. This is usefull for the
	   standart GNUBLIN edition, if you don't want to use the little tespoint.

endmenu

#menu "GNUBLIN IRQ INITIALISATION(not supportet yet!)"
#	depends on ARCH_LPC31XX

	
#choice 
#	 bool "Choice menu"
	 
#		config IRQ_GPIO_LOW_ACTIVE
#		bool "LOW"
#		config IRQ_GPIO_HIGH_ACTIVE
#	 	bool "HIGH"
#	endchoice
#endmenu
```

## Teil_A/software/bootloader/apex-1.6.8-vanilla/src/mach-lpc313x/Kconfig
```kconfig
if ARCH_LPC313X

choice
	prompt "LPC313X Implementations"
	#default MACH_EA313x_V1
	default MACH_EPLPC3131_V1

config MACH_VAL3153
	bool "NXP validation board VAL3131"
	select USES_CS8900
	select USES_NAND
	select USES_SPINOR

config MACH_VAL3154
	bool "NXP validation board VAL3154"
	select HAS_ANALOG_DIE
	select USES_NAND

config MACH_EA313x_V1
	bool "EA313x 1.0 board w/o ethernet"
	select USES_NAND
	select USES_SPINOR

config MACH_EA313x_V2
	bool "EA313x 2.0 board w/ ethernet"
	select USES_DM9000
	select USES_NAND
	select USES_SPINOR
	
config MACH_EA3152
	bool "EA3152 board w/ ethernet"
	select HAS_ANALOG_DIE
	select USES_DM9000
	select USES_NAND
	select USES_SPINOR

config MACH_EPLPC3131_V1
		bool "Embedded Projects GmbH LPC3131"


endchoice


menu "Platform Setup"

config OSC_FREQ
	int "Crystal frequency"
	default 12000000 
	depends on ARCH_LPC313X
	help
	  Change this if using crystal other than 12MHz. 
choice
	prompt "PLL frequency"
	default PLL_180

config PLL_90
	bool "Set PLL/ARM frequency at 90MHz and AHB=45MHz"

config PLL_180
	bool "Set PLL/ARM frequency at 180MHz and AHB=90MHz"

config PLL_270
	bool "Set PLL/ARM frequency at 270MHz and AHB=90MHz."
	help
	  This frequency is garunteed only for LPC314x series with core
	  voltage set to 1.3v. 


endchoice

config DYNAMIC_CLOCKS
	bool "Enable automatic clock scaling"
	help
	  Enables automatic clock scaling feature present in CGU. Whenever
	  AHB bus system is inactive CGU automaticly switches the FDC0 to FDC7
	  to DynFDC0 to DyncFDC7.   
	  
config USB_BOOT
	bool "Enable LPC313x USB boot method"
	help
	  Make sure you have copied usbmsc.d file under 
	  src\mach-lpc313x\usb directory.   
	  
config ATAG_PHYS
	hex "Physical address for ATAGs list"
	default "0x30000100"
	depends on ATAG
	help
	  This is the address where APEX will construct the ATAG list
	  before starting the Linux kernel.  This address should be
	  within the first 16KiB of physical RAM.  Don't change this
	  value unless you know what you are doing. 

config ARCH_NUMBER
	int
	default 9999 if (MACH_VAL3153)
	default 9998 if (MACH_EA313x_V1 || MACH_EA313x_V2 || MACH_EPLPC3131_V1)
	default 9997 if (MACH_VAL3154)
	default 9996 if (MACH_EA3152)

config APEX_VMA
	hex "APEX Runtime Address"
	default "0x11029000"

config KERNEL_LMA
	hex "Kernel Load Address"
	default "0x30008000"

config USE_RAMDISK
	bool "Enable ramdisk options"
	default n
	help
	  This option doesn't enable the ramdisk, per se.  It enables
	  other configuration options that help setup a default
	  ramdisk.  The kernel command line and the APEX startup
	  commands may be overridden to perform the same steps.

	  There is a separate option in the Environment section that
	  controls whether or not APEX copies the ramdisk from flash
	  into RAM at startup.  That is where the ramdisk region is
	  defined.

config RAMDISK_LMA
	hex "Ramdisk load address"
	default "0x32000000"
	depends on USE_RAMDISK
	help
	  This option sets the physical load address for an initial
	  ramdisk (a.k.a initrd).

config RAMDISK_SIZE
	hex "Ramdisk compressed size"
	default "0x00300000"
	depends on USE_RAMDISK
	help
	  This option sets the size, in bytes, of the initial ramdisk
	  (a.k.a. initrd).  This is the size of the compressed initrd
	  image.

config AUTOFORMAT_BLOCK0
	bool "Autoformat NAND block 0"
	default y
	depends on DRIVER_NAND
	help
	  The LPC31xx devices use block 0 of FLASH to store device bad
	  block and NAND boot information. If this option is enabled,
	  this information will be built automatically if it doesn't
	  exist. (A image of all the factory bad blocks are stored in
	  here.) It is highly recommended that this option always be
	  enabled. If it is not enabled, the device should be formatted
	  manually with the lpcnand format command. If this is not
	  done, the device will lose it's factory bad block information
	  as soon as writes start occuring to the device. See the
	  additional information about NAND FLASH included with the BSP
	  for more information.

choice
	prompt "LPC NAND device"
	depends on DRIVER_NAND
	default MICRON_MT29F2G08

config MICRON_MT29F2G08
	bool "MICRON NAND MT29F2G08 device."

config MICRON_MT29F4G08
	bool "MICRON NAND MT29F4G08 device."

config SAMSUNG_K9K8G
	bool "SAMSUNG NAND K9K8G device."

config TOSHIBA_TC58DVM82A
	bool "TOSHIBA C58DVM82A device (small block)."

endchoice

config DRIVER_SPINOR
	bool "SPI NOR Flash"
	depends on USES_SPINOR=y
	default y
	help
	  This driver implements a SPI-NOR flash driver
	  which works with most contemporary SPI-NOR flash chips. 

choice
	prompt "SPI NOR device"
	depends on DRIVER_SPINOR
	default SPINOR_AT45DB

config SPINOR_AT45DB
	bool "Atmel SPINOR AT45DB device."

endchoice


choice
	prompt "Choose RAM size"
	default RAM_SIZE_8MB 
	help
	    With this Option you can choose the correct size of your RAM. 

config  RAM_SIZE_8MB
	bool "8MB RAM"

config  RAM_SIZE_32MB
	bool "32MB RAM"

config  RAM_SIZE_64MB
	bool "64MB RAM"

endchoice

choice
   prompt "Display Controller"
   default DISP_NONE
   help
       Select the timing for display controllers. 
config DISP_NONE
   bool "none"

config  DISP_SSD1963
   bool "SSD1963"

config  DISP_MD050SD
   bool "MD050SD"

config  DISP_SSD1289
   bool "SSD1289"

endchoice



endmenu

config MACH
	string
	default "lpc313x"

config ARCH_LPC313X
	bool
	select CPU_ARMV5
	select CPU_ARM9
	select CPU_ARM926T


config HAS_ANALOG_DIE
	bool

config USES_SPINOR
	bool

endif
```

## Teil_A/software/bootloader/apex-1.6.8-vanilla/src/mach-orion5x/Kconfig
```kconfig
if ARCH_ORION5X

choice
	prompt "Marvell Orion 5x Implementations"
	default MACH_HP_MV2120

config MACH_HP_MV2120
	bool "HP MediaVault 2120"
	select ARCH_88F5182
	select USES_NOR_CFI
	select USES_NOR_BOOTFLASH
	select INLINE_PLATFORM_INITIALIZATION

endchoice

menu "Platform Setup"

config ATAG_PHYS
	hex "Physical address for ATAGs list"
	default "0x00000100"
	depends on ATAG
	help
	  This is the address where APEX will construct the ATAG list
	  before starting the Linux kernel.  This address should be
	  within the first 16KiB of physical RAM.  Don't change this
	  value unless you know what you are doing. 

config ARCH_NUMBER
	int
	default 526 if MACH_HP_MV2120

config APEX_VMA
	hex "APEX Runtime Address"
	default "0x00200000"

config KERNEL_LMA
	hex "Kernel Load Address"
	default "0x00008000"

config USE_RAMDISK
	bool "Enable ramdisk options"
	default n
	help
	  This option doesn't enable the ramdisk, per se.  It enables
	  other configuration options that help setup a default
	  ramdisk.  The kernel command line and the APEX startup
	  commands may be overridden to perform the same steps.

	  There is a separate option in the Environment section that
	  controls whether or not APEX copies the ramdisk from flash
	  into RAM at startup.  That is where the ramdisk region is
	  defined.

config RAMDISK_LMA
	hex "Ramdisk load address"
	default "0x04000000"
	depends on USE_RAMDISK
	help
	  This option sets the physical load address for an initial
	  ramdisk (a.k.a initrd).

config RAMDISK_SIZE
	hex "Ramdisk compressed size"
	default "0x00300000"
	depends on USE_RAMDISK
	help
	  This option sets the size, in bytes, of the initial ramdisk
	  (a.k.a. initrd).  This is the size of the compressed initrd
	  image.

config SDRAM_BANK0
	bool "Enable SDRAM Bank 0"
	default y

config SDRAM_BANK1
	bool "Enable SDRAM Bank 1"
	depends on SDRAM_BANK0
	default n 

config EXTENDED_CPUINFO
	bool "Extended CPU into"
	depends on n
	default n
	help
	  For most targets, CPU info is a simple report of the
	  ARM CPU registers available on most cores.  This option
	  enables a report on many other registers.

	  *** Currently unimplemented.

endmenu

menu "Platform Drivers"

endmenu

config MACH
	string
	default "orion5x"

config ARCH_88F5182
	bool
	select CPU_ARMV5
	select CPU_ARMV5TE

endif
```
