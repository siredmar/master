## gnublin/apex-1.6.8-vanilla/src/mach-s3c2410/Kconfig
```kconfig
if ARCH_S3C2410

choice
	prompt "S3C2410 Implementations"
	default MACH_M7200

config MACH_M7200
	bool "American Microsystems M7200"
	select USES_NOR_CFI
	select USES_NOR_BOOTFLASH

endchoice

menu "Platform Setup"

config ATAG_PHYS
	hex "Physical address for ATAGs list"
	default "0x30000100"
	depends on ATAG
	help
	  This is the address where APEX will construct the ATAG list
	  before starting the Linux kernel.  This address should be
	  within the first 16KiB of physical RAM.  Don't change this
	  value unless you know what you are doing. 

config ARCH_NUMBER
	int
	default 193

config APEX_VMA
	hex "APEX runtime address"
	default "0x30200000"

config KERNEL_LMA
	hex "Kernel load address"
	default "0x30008000"

config USE_RAMDISK
	bool "Enable ramdisk options"
	default y
	help
	  This option doesn't enable the ramdisk, per se.  It enables
	  other configuration options that help setup a default
	  ramdisk.  The kernel command line and the APEX startup
	  commands may be overridden to perform the same steps.

	  There is a separate option in the Environment section that
	  controls whether or not APEX copies the ramdisk from flash
	  into RAM at startup.  That is where the ramdisk region is
	  defined.

config RAMDISK_LMA
	hex "Ramdisk load address"
	default "0x30800000"
	depends on USE_RAMDISK
	help
	  This option sets the physical load address for an initial
	  ramdisk (a.k.a initrd).

config RAMDISK_SIZE
	hex "Ramdisk compressed size"
	default "0x00100000"
	depends on USE_RAMDISK
	help
	  This option sets the size, in bytes, of the initial ramdisk
	  (a.k.a. initrd).  This is the size of the compressed initrd
	  image.

config SDRAM_BANK0
	bool "Enable SDRAM bank 0"
	default y

config NOR_BUSWIDTH
	int "Width of NOR flash bus"
	default "16"
	
config NOR_BANK0
	bool "Enable NOR flash bank 0"
	default y

config NOR_BANK0_START
	hex "Physical address of NOR flash bank 0"
	default "0x00000000"
	depends on NOR_BANK0

config NOR_BANK0_LENGTH
	hex "Size, in bytes, of NOR flash bank 0"
	default "0x04000000"
	depends on NOR_BANK0

endmenu

config MACH
	string
	default "s3c2410"

config ARCH_S3C2410
	bool
	select CPU_ARMV4
	select CPU_ARM920T
	select DRIVER_NOR_CFI_NO_BUFFERED
endif
```

## gnublin/apex-1.6.8/src/mach-lh7952x/Kconfig
```kconfig
if ARCH_LH7952X

choice
	prompt "LH7952X Implementations"
	default MACH_LPD79524

config MACH_LNODE80
	bool "LNode80 Arm Development System"
	select ARCH_LH79520
	select USES_NOR_CFI
	select USES_NOR_BOOTFLASH
	select DRIVERS_LH

config MACH_LPD79520
	bool "Logic Product Development LPD79520"
	select ARCH_LH79520
	select MACH_LPD7952X
	select USES_NOR_CFI
	select USES_COMPACTFLASH
	select USES_NOR_BOOTFLASH
	select USES_SMC91X
	select DRIVERS_LH
	select HAS_LH_CLCDC

config MACH_LPD79524
	bool "Logic Product Development LPD79524"
	select ARCH_LH79524
	select MACH_LPD7952X
	select USES_NOR_CFI
	select USES_COMPACTFLASH
	select USES_NOR_BOOTFLASH
	select USES_NAND
	select USES_NAND_BOOTFLASH
	select DRIVERS_LH
	select HAS_LH_ADC
	select HAS_LH_CLCDC

config MACH_KEV79524
	bool "Sharp KEV79524"
	select ARCH_LH79524
	select USES_NOR_CFI
	select USES_NOR_BOOTFLASH
	select USES_NAND_BOOTFLASH
	select DRIVERS_LH
	select HAS_LH_ADC
	select HAS_LH_CLCDC

config MACH_KEV79525
	bool "Sharp KEV79525"
	select ARCH_LH79525
	select USES_NOR_CFI
	select USES_NOR_BOOTFLASH
	select USES_NAND_BOOTFLASH
	select DRIVERS_LH
	select HAS_LH_ADC
	select HAS_LH_CLCDC

config MACH_MOTO_EDGE
	bool "Edge Integration - LPD79524"
	select ARCH_LH79524
	select MACH_LPD7952X
	select USES_NOR_CFI
	select USES_NOR_BOOTFLASH
	select USES_NAND_BOOTFLASH
	select DRIVERS_LH
	select HAS_LH_ADC
	select HAS_LH_CLCDC
	select USES_NAND
	select INLINE_PLATFORM_INITIALIZATION

endchoice

menu "Platform Setup"

choice
	prompt "CPU/Peripheral Clock"
	default FREQ_52_52
	depends on ARCH_LH79524 || ARCH_LH79525

config FREQ_51_51
	bool "FCLK 51 MHz - HCLK 51 MHz"
	help
	  This setting configures the PLL for 101.606MHz, HCLK and
	  FCLK will be 50.8032 MHz.  This is the default setting and
	  is known to work reliably on the LPD CardEngines.

config FREQ_76_51
	bool "FCLK 76 MHz - HCLK 51 MHz"
	help
	  This setting configures the PLL for 304.8192 MHz, HCLK will
	  be 50.8032 MHz and FCLK will be 76.2048 MHz.  This setting
	  may cause the system to run unreliably.

endchoice 

config ATAG_PHYS
	hex "Physical address for ATAGs list"
	default "0x20000100"
	depends on ATAG
	help
	  This is the address where APEX will construct the ATAG list
	  before starting the Linux kernel.  This address should be
	  within the first 16KiB of physical RAM.  Don't change this
	  value unless you know what you are doing. 

config ARCH_NUMBER
	int
	default 537 if MACH_LNODE80
	default 537 if MACH_LPD79520
	default 609 if MACH_LPD79524
	default 609 if MACH_KEV79524
	default 610 if MACH_KEV79525

config APEX_VMA
	hex "APEX runtime address"
	default "0x20200000"

config KERNEL_LMA
	hex "Kernel load address"
	default "0x20008000"

config USE_RAMDISK
	bool "Enable ramdisk options"
	depends on MACH_LNODE80
	default y
	help
	  This option doesn't enable the ramdisk, per se.  It enables
	  other configuration options that help setup a default
	  ramdisk.  The kernel command line and the APEX startup
	  commands may be overridden to perform the same steps.

	  There is a separate option in the Environment section that
	  controls whether or not APEX copies the ramdisk from flash
	  into RAM at startup.  That is where the ramdisk region is
	  defined.

config RAMDISK_LMA
	hex "Ramdisk load address"
	default "0x20400000"
	depends on USE_RAMDISK

config SDRAM_BANK0
	bool "Enable SDRAM bank 0"
	default y

config SDRAM_BANK1
	bool "Enable SDRAM bank 1"
	depends on SDRAM_BANK0
	depends on !MACH_LNODE80
	default y if MACH_KEV79524 

config SDRAM_FORCE16BIT
	bool "Force SDRAM bus width to 16 bits"
	depends on ARCH_LH79524
	help
	  This option allow for performance testing of the SDRAM
	  memory bus.  It configures the SDRAM controller to use only
	  the lower 16 bits of the bus, emulating [sic] the LH79525.

	  There is no good reason to use the option for production systems. 

config NOR_BUSWIDTH
	int "Width of NOR flash bus"
	default "16"
	
config NOR_BANK0
	bool "Enable NOR flash bank 0"
	default y

config NOR_BANK0_START
	hex "Physical address of NOR flash bank 0"
	default "0x40000000" if ARCH_LH79520
	default "0x44000000" if ARCH_LH79524
	default "0x44000000" if ARCH_LH79525
	depends on NOR_BANK0

config NOR_BANK0_LENGTH
	hex "Size, in bytes, of NOR flash bank 0"
	default "0x00400000" if MACH_LNODE80
	default "0x00800000" if MACH_LPD7952X
	default "0x00400000" if MACH_KEV79524
	default "0x00400000" if MACH_KEV79525
	depends on NOR_BANK0

config NOR_BANK1
	bool "Enable NOR flash bank 1"
	depends on NOR_BANK0
	depends on !MACH_LNODE80
	default n if MACH_LPD79520
	default y if MACH_LPD79524

config NOR_BANK1_START
	hex "Physical address of NOR flash bank 1"
	default "0x45000000"
	depends on NOR_BANK1

config NOR_BANK1_LENGTH
	hex "Size, in bytes, of NOR flash bank 1"
	default "0x00800000"
	depends on NOR_BANK1

config NAND_LPD
	bool "Enable LPD enhanced NAND flash access"
	depends on MACH_LPD79524
	default y if MACH_LPD79524
	help
	  This options enables a mode for accessing NAND flash that
	  makes it possible to read NAND flash, NOR flash, and
	  CompactFlash simultaneously.

endmenu

menu "Platform Drivers"

config DRIVER_EMAC_LH79524
	bool "LH79524/5 EMAC"
	depends on ARCH_LH79524 || ARCH_LH79525
	select DRIVER_CPLD_SPI if MACH_LPD79524
	select USE_ETHERNET
	default y
	help
	  This driver initializes the built-in Ethernet MAC of the
	  Sharp lh79524/5. 

config CODEC
	bool "Audio Codec"
	depends on MACH_LPD79524
	default n
	help
	  This driver includes commands to initialize and test the
	  TI audio codec as well as the CPUs SSP module.  

	  You will not be able to use this code without first creating
	  PCM test data.  It's best to leave this option disabled.

config CODEC_LH79520
	bool "Audio Codec"
	depends on MACH_LPD79520
	default n
	help
	  This driver includes commands to initialize and test the
	  TI audio codec as well as the CPUs SSP module.

config DRIVER_CPLD_SPI
	bool "LPD7952x CPLD SPI devices"
	depends on MACH_LPD79520 || MACH_LPD79524
	default n
	help
	  This driver implemets EEPROM SPI driver for the LPD 7952x
	  Card Engines.

config ADS7843
	bool "ADS7843 touchscreen test"
	depends on MACH_LPD79520
	default n
	help
	  This options implements a test routing for the ADS7843
	  touchscreen controller. 

endmenu

config MACH
	string
	default "lh7952x"

config ARCH_LH79520
	bool
	select CPU_ARMV4
	select CPU_ARM7
	select CPU_ARM720T

config ARCH_LH79524
	bool
	select CPU_ARMV4
	select CPU_ARM7
	select CPU_ARM720T

config ARCH_LH79525
	bool
	select CPU_ARMV4
	select CPU_ARM7
	select CPU_ARM720T

config MACH_LPD7952X
	bool

endif
```

## gnublin/apex-1.6.8/src/net/Kconfig
```kconfig
if USE_ETHERNET

menu "Ethernet Networking"

config ETHERNET
	bool "Ethernet Network Stack"
	select USES_PATHNAME_PARSER
	default y
	help
	  This options enabled the Ethernet network stack, protocols
	  and commands. 

config CMD_IPCONFIG
	bool "IP configuration command"
	depends on ETHERNET
	default y
	help
	  This command provides a user interface to the IP address
	  configuration methods.

config CMD_IPCONFIG_STATIC
	bool "Static method"
	depends on CMD_IPCONFIG
	default y
	help
	  This method allows for manual configuration of the IP
	  address and gateway.

config CMD_IPCONFIG_RARP
	bool "RARP method"
	depends on CMD_IPCONFIG
	default y
	help
	  This method configures the IP address using the RARP
	  protocol.

config CMD_IPCONFIG_BOOTP
	bool "BOOTP method"
	depends on CMD_IPCONFIG
	default n
	help
	  This method configures the IP address using the BOOTP
	  protocol.

config CMD_IPCONFIG_DHCP
	bool "DHCP method"
	depends on CMD_IPCONFIG
	default n
	help
	  This method configures the IP address using the DHCP
	  protocol.

config PROTO_ICMP_ECHO
	bool "ICMP Echo (Ping) Handler"
	depends on ETHERNET
	default y
	help
	  This option enables an ICMP request handler.  With it, the
	  network stack will answer ICMP echo requests.  It is OK to
	  leave this option N as this feature is unnecessary for
	  proper operation of the network stack.

config CMD_PING
	bool "Ping Command"
	depends on ETHERNET
	default n
	help
	  This option add the ping command for testing network
	  connectivity.

config CMD_ARP
	bool "ARP Command for Testing"
	depends on ETHERNET
	default n
	help
	  This option adds an arp command for testing the ethernet
	  interface.

config CMD_TFTP
	bool "TFTP File Transfer Command"
	depends on ETHERNET
	default y
	help
	  This protocol transfers files over the network.

endmenu

endif

config MAC_FILTER
	bool

config USE_ETHERNET
	bool
```

## gnublin/gnublin-lpc3131-3.3.0-master/linux-3.3.0-lpc313x/Documentation/devicetree/bindings/i2c/pnx.txt
```
* NXP PNX I2C Controller

Required properties:

 - reg: Offset and length of the register set for the device
 - compatible: should be "nxp,pnx-i2c"
 - interrupts: <a b> where a is the interrupt number and b is a
   field that represents an encoding of the sense and level
   information for the interrupt
 - interrupt-parent: the phandle for the interrupt controller that
   services interrupts for this device.

Optional properties:

 - clock-frequency: desired I2C bus clock frequency in Hz, Default: 100000
 - pnx,timeout: I2C bus timeout in milliseconds, Default: 10
 - slave-addr: Address used by the controller, Hardware default: 110

Examples:

	i2c1: i2c@400A0000 {
		compatible = "nxp,pnx-i2c";
		reg = <0x400A0000 0x100>;
		interrupt-parent = <&mic>;
		interrupts = <51 0>;
	};

	i2c2: i2c@400A8000 {
		compatible = "nxp,pnx-i2c";
		reg = <0x400A8000 0x100>;
		interrupt-parent = <&mic>;
		interrupts = <50 0>;
		clock-frequency = <100000>;
		pnx,timeout = <100>;
		slave-addr = <111>;
	};
```

## gnublin/gnublin-lpc3131-3.3.0-master/linux-3.3.0-lpc313x/arch/arm/Kconfig.rej
```kconfig
--- arch/arm/Kconfig	2012-03-19 00:15:34.000000000 +0100
+++ arch/arm/Kconfig	2012-10-05 21:14:50.411948130 +0200
@@ -983,6 +983,20 @@
 	select USE_OF
 	help
 	  Support for Xilinx Zynq ARM Cortex A9 Platform
+
+config ARCH_LPC31XX
+	bool "NXP LPC31XX series"
+	select CPU_ARM926T
+	select GENERIC_GPIO
+	select CLKDEV_LOOKUP
+	select ARCH_REQUIRE_GPIOLIB
+	select ARCH_USES_GETTIMEOFFSET
+	help
+	  Say Y here for systems based on one of the NXP LPC313x & LPC315x
+	  System on a Chip processors.  These CPUs include an ARM926EJS
+	  core with a wide array of integrated devices for
+	  hand-held and low-power applications.
+
 endchoice
 
 #
@@ -1103,6 +1117,8 @@
 
 source "arch/arm/mach-w90x900/Kconfig"
 
+source "arch/arm/mach-lpc31xx/Kconfig"
+
 # Definitions to make life easier
 config ARCH_ACORN
 	bool
@@ -1743,7 +1759,7 @@
 		   ARCH_LUBBOCK || MACH_MAINSTONE || ARCH_NETWINDER || \
 		   ARCH_OMAP || ARCH_P720T || ARCH_PXA_IDP || \
 		   ARCH_SA1100 || ARCH_SHARK || ARCH_VERSATILE || \
-		   ARCH_AT91 || ARCH_DAVINCI || \
+		   ARCH_AT91 || ARCH_DAVINCI || ARCH_LPC31XX || \
 		   ARCH_KS8695 || MACH_RD88F5182 || ARCH_REALVIEW
 	help
 	  If you say Y here, the LEDs on your machine will be used
@@ -1759,7 +1775,7 @@
 config LEDS_TIMER
 	bool "Timer LED" if (!ARCH_CDB89712 && !ARCH_OMAP) || \
 			    OMAP_OSK_MISTRAL || MACH_OMAP_H2 \
-			    || MACH_OMAP_PERSEUS2
+			    || MACH_OMAP_PERSEUS2 || ARCH_LPC31XX
 	depends on LEDS
 	depends on !GENERIC_CLOCKEVENTS
 	default y if ARCH_EBSA110
@@ -1778,7 +1794,7 @@
 	bool "CPU usage LED" if (!ARCH_CDB89712 && !ARCH_EBSA110 && \
 			!ARCH_OMAP) \
 			|| OMAP_OSK_MISTRAL || MACH_OMAP_H2 \
-			|| MACH_OMAP_PERSEUS2
+			|| MACH_OMAP_PERSEUS2 || ARCH_LPC31XX
 	depends on LEDS
 	help
 	  If you say Y here, the red LED will be used to give a good real
```

## gnublin/gnublin-lpc3131-3.3.0-master/linux-3.3.0-lpc313x/drivers/misc/lpc31xx/Kconfig
```kconfig
menuconfig NEW_LPC313x_IO
	bool "NxP lpc313x IO drivers (ADC, PWM, ...)"
	help
	  Say Y to enable support for lpc313x series MCU's on-chip peripherials like AD-converter and Pulse Width Modulator..

if NEW_LPC313x_IO

config LPC313x_ADC
	tristate "lpc313x ADC support"
	help
	  Say Y to enable the ADC driver, when built as a module, the module will be called "lpc313x_adc".
	  
config LPC313x_PWM
	tristate "lpc313x PWM support"
	help
	   Say Y to enable the PWM driver, when built as a moule, the module will be called "lpc313x_pwm".

endif
```

## gnublin/linux-2.6.33-lpc313x-fb/drivers/net/wireless/rtl8188eu/Kconfig
```kconfig
config RTL8188EU
	tristate "Realtek 8188E USB WiFi"
	depends on USB
    select WIRELESS_EXT
    select WEXT_PRIV
	---help---
	  This is a driver for RTL8188EU based cards.
	  These are USB based chips found in devices such as:
	  TP-LINK TL-WN725N
```
