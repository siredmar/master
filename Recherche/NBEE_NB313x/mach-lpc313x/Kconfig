## Teil_A/software/bootloader/apex-1.6.8.broken2/src/drivers-lh/Kconfig
```kconfig
if DRIVERS_LH

menu "Sharp-LH Drivers"

config DRIVER_LH_ADC
	bool "ADC"
	depends on HAS_LH_ADC
	default n
	help
	  This driver includes commands to initialize and test the
	  ADC/touchscreen controller.

config DRIVER_LH_MMC
	bool "MMC"
	depends on HAS_LH_MMC
	default n
	help
	  This driver supports the MMC/SD
	  (MultiMediaCard/SecureDigital) controller.

config DRIVER_LH_I2C
	bool "I2C"
	depends on HAS_LH_I2C
	default n
	help
	  This driver supports IO from the I2C (BMI in Single Wire mode) 
	  interface.

config DRIVER_LH_CLCDC
	bool "Color LCD"
	depends on HAS_LH_CLCDC
	default n
	help
	  This driver initializes the CLCD controller.  It is
	  necessary if you want to show a splash screen. 

config LCD_BGR
	bool "Use BGR pel encoding"
	depends on DRIVER_LH_CLCDC
	default n
	help
	  The AMBA framebuffer device drives red from bits 0-4 in the
	  TFT color value, and blue from bits 10-14 (or 11-15).  Setting
	  this option swaps these roles.  This may be important if the
	  kernel requires that blue be in the least significant bits
	  of each framebuffer pel.

config LCD_565
	bool "Use 565 pel encoding"
	depends on DRIVER_LH_CLCDC
	default n
	help
	  The AMBA framebuffer device drives green from bits 5-9 or 5-10
	  depending on the state of this option.  In 565 mode, the
	  green has one ore bit than the other components.

config LCD_RETAIN_SPLASH
	bool "Retain splash image through kernel boot"
	depends on DRIVER_LH_CLCDC
	default n
	help
	  This option moves the frame buffer allocation to the top of
	  RAM, removes that memory from the pool passed to the kernel,
	  and then passes that frame buffer address to the kernel so
	  that it can maintain continuity of the display.  It also
	  prevents the LCD driver from disabling the display when it
	  passes control during boot or go commands.

choice
	prompt "LCD Panel"
	depends on DRIVER_LH_CLCDC
	default LCD_3_5_QVGA_20

config LCD_3_5_QVGA_20
	bool "LCD 3.5\" QVGA w/HRTFT IC"

config LCD_5_7_QVGA_10
	bool "LCD 5.7\" QVGA"

config LCD_6_4_VGA_10
	bool "LCD 6.4\" VGA"

config LCD_12_1_SVGA_10
	bool "LCD 12.1\" SVGA"

config LCD_NL2432HC22_40A
	bool "NEC 3.5\" Portrait QVGA"

config LCD_LQ036Q1DA01
	bool "Sharp 9.1cm (3.6\") Landscape QVGA"

config LCD_LQ035Q7DH06
	bool "Sharp 3.5\" Portrait QVGA"

config LCD_TD035TTEA1
	bool "One Stop Display 3.5\" Landscape QVGA"

config LCD_NOKIA_WIDE
	bool "Nokia Wide Landscape HVGA"

endchoice

endmenu

endif

config HAS_LH_ADC
	bool

config HAS_LH_MMC
	bool

config HAS_LH_I2C
	bool

config HAS_LH_CLCDC
	bool

config DRIVERS_LH
	bool
```

## Teil_A/software/bootloader/apex-1.6.8/src/mach-mx3/Kconfig
```kconfig
if ARCH_MX3

choice
	prompt "Freescale MX3 Implementations"
	default MACH_MX31ADS

config MACH_MX31ADS
	bool "Freescale MX31 Development Board"
	select ARCH_MX31
	select USES_NOR_CFI
	select USES_NOR_BOOTFLASH
	select USES_COMPACTFLASH
	select USES_CS8900
	select INLINE_PLATFORM_INITIALIZATION

config MACH_EXBIBLIO_ROSENCRANTZ
	bool "Exbiblio Rosencrantz Board"
	select ARCH_MX31
	select USES_DM9000
	select USES_IPU_TEST
	select INLINE_PLATFORM_INITIALIZATION

config MACH_PHYTEC_PCM037
	bool "PHYTEC PCM037 MX31 Development Board"
	select ARCH_MX31
	select USES_NOR_CFI
	select USES_NOR_BOOTFLASH
	select USES_SMC91X
	select INLINE_PLATFORM_INITIALIZATION

config MACH_KARMA5
	bool "Panasonic KarmaV"
	select ARCH_MX31
	select USES_DM9000
	select USES_NOR_CFI
	select USES_NOR_BOOTFLASH
	select USES_IPU_TEST
	select INLINE_PLATFORM_INITIALIZATION

endchoice

menu "Platform Setup"

choice
	prompt "CPU/Peripheral Clock"
	default FREQ_533_133_66

config FREQ_533_133_66
	bool "MPLL 533 MHz - HCLK 133 MHz - IPGCLK 66MHz"
	help
	  This setting configures the CPU frequency to 532 MHz.

config FREQ_399_133_66
	bool "MPLL 399 MHz - HCLK 133 MHz - IPGCLK 66MHz"
	help
	  This setting configures the CPU frequency to 399 MHz.

config FREQ_208_104_52
	bool "MPLL 208 MHz - HCLK 104 MHz - IPGCLK 52MHz"
	help
	  This setting configures the CPU frequency to 208 MHz.

endchoice

config ATAG_PHYS
	hex "Physical address for ATAGs list"
	default "0x80000100"
	depends on ATAG
	help
	  This is the address where APEX will construct the ATAG list
	  before starting the Linux kernel.  This address should be
	  within the first 16KiB of physical RAM.  Don't change this
	  value unless you know what you are doing. 

config ARCH_NUMBER
	int
	default 447 if MACH_MX31ADS
	default 1348 if MACH_EXBIBLIO_ROSENCRANTZ
	default 1348 if MACH_KARMA5
	default 447 if MACH_PHYTEC_PCM037

config APEX_VMA
	hex "APEX Runtime Address"
	default "0x80200000"

config KERNEL_LMA
	hex "Kernel Load Address"
	default "0x80008000"

config USE_RAMDISK
	bool "Enable ramdisk options"
	default n
	help
	  This option doesn't enable the ramdisk, per se.  It enables
	  other configuration options that help setup a default
	  ramdisk.  The kernel command line and the APEX startup
	  commands may be overridden to perform the same steps.

	  There is a separate option in the Environment section that
	  controls whether or not APEX copies the ramdisk from flash
	  into RAM at startup.  That is where the ramdisk region is
	  defined.

config RAMDISK_LMA
	hex "Ramdisk load address"
	default "0x84000000"
	depends on USE_RAMDISK
	help
	  This option sets the physical load address for an initial
	  ramdisk (a.k.a initrd).

config RAMDISK_SIZE
	hex "Ramdisk compressed size"
	default "0x00300000"
	depends on USE_RAMDISK
	help
	  This option sets the size, in bytes, of the initial ramdisk
	  (a.k.a. initrd).  This is the size of the compressed initrd
	  image.

config SDRAM_BANK0
	bool "Enable SDRAM Bank 0"
	default y

config SDRAM_BANK1
	bool "Enable SDRAM Bank 1"
	depends on SDRAM_BANK0
	default n 

choice
	prompt "Console UART"
	default MX31_UART1

config MX31_UART1
	bool "MX31 internal UART1"

config MX31ADS_UARTA
	bool "MX31ADS external UARTA"
	depends on MACH_MX31ADS

endchoice

config EXCEPTIONS
       bool "Enable exception vectors"
       depends on MMU
       default y
       help
         Intalls exception vector handlers.  This option is required
         for interrupts as well, though interrupts are not implemented
         for this platform.  Set this option to Y to receive reports
         on undefined instructions and data/instruction fetch aborts. 

config IPU_TEST
	bool "Enable IPU test commands"
	depends on USES_IPU_TEST
	default n
	help
	  The IPU handles communication between video sensors, the
	  MPEG4 video encoder, and display technology.  It is a very
	  complex portion of the CPU.  The code here is helpful for
	  testing and debugging IPU problems.  This code depends on
	  some platform specific hardware.

config MX31_I2C_DRIVER
       bool "Enable I2C driver"
       default n
       help
         This I2C driver is for debugging.

config CMD_WM8955
       bool "Define WM8955L command"
       default n
       depends on MX31_I2C_DRIVER 

config DRIVER_WM8955_I2C_DRIVER
	string "Underlying I2C driver"
	depends on CMD_WM8955
	default "i2c:/0x1a"
	help
	  The I2C driver region used to communicate with the WM8955L
	  codec.
	
config EXTENDED_CPUINFO
	bool "Extended CPU into"
	depends on n
	default n
	help
	  For most targets, CPU info is a simple report of the
	  ARM CPU registers available on most cores.  This option
	  enables a report on many other registers.

	  *** Currently unimplemented.

endmenu

menu "Platform Drivers"

endmenu

config MACH
	string
	default "mx3"

config ARCH_MX31
	bool
	select CPU_ARMV6
	select CPU_ARM11
	select CPU_ARM1136

endif

config USES_IPU_TEST
       bool
```

## gnublin/apex-1.6.8-vanilla-broken/src/mach-lh7a40x/Kconfig
```kconfig
if ARCH_LH7A40X

choice
	prompt "LH7A40X Implementations"
	default MACH_LPD7A404

config MACH_LPD7A400
	bool "Logic Product Development LPD7A400"
	select ARCH_LH7A400
	select MACH_LPD7A40X
	select USES_NOR_CFI
	select USES_COMPACTFLASH
	select USES_NOR_BOOTFLASH
	select USES_SMC91X
	select DRIVERS_LH
	select HAS_LH_CLCDC

config MACH_LPD7A404
	bool "Logic Product Development LPD7A404"
	select ARCH_LH7A404
	select MACH_LPD7A40X
	select USES_NOR_CFI
	select USES_COMPACTFLASH
	select USES_NOR_BOOTFLASH
	select USES_SMC91X
	select DRIVERS_LH
	select HAS_LH_ADC
	select HAS_LH_CLCDC
	select HAS_LH_MMC

config MACH_TROUNCER
	bool "Interalia TROUNCER"
	select ARCH_LH7A404
	select USES_NOR_CFI
	select USES_COMPACTFLASH
	select USES_NOR_BOOTFLASH
	select DRIVERS_LH
	select HAS_LH_ADC
	select HAS_LH_MMC

config MACH_COMPANION
	bool "Comsonics Companion"
	select ARCH_LH7A404
	select DRIVERS_LH
	select HAS_LH_ADC
	select HAS_LH_CLCDC
	select HAS_LH_MMC
	select HAS_LH_I2C
	select USES_DM9000
	select USES_COMPANION_EVT1_BOOT
	select USES_COMPANION_EVT2_BOOT
	select USES_NAND
	select USES_NAND_BOOTFLASH

config MACH_KARMA
	bool "Panasonic Karma"
	select ARCH_LH7A404
	select USES_NOR_CFI
	select DRIVERS_LH
	select HAS_LH_ADC
	select HAS_LH_CLCDC
	select HAS_LH_MMC
	select HAS_LH_I2C
	select USES_DM9000
	select USES_NOR_BOOTFLASH

endchoice

config MACH_LPD7A404_80000258
	bool "Support USB device control of the 80000258"
	depends on MACH_LPD7A404
	default n
	help
	  A early release of the LPD7A404, the -10 board, inverts the
	  output of the USB_PWR_EN control line from the CPU.  The
	  only way to drive it properly is to code the driver to do
	  so.  There is no way to detect this older hardware revision.
	  The part number on this older CardEngine is 80000258.  If
	  you want proper USB device operation for the -10 board,
	  choose this option.

menu "Platform Setup"

choice
	prompt "CPU/Peripheral Clock"
	default FREQ_200_100_50 if !MACH_TROUNCER
	default FREQ_200_66_33  if  MACH_TROUNCER

config FREQ_200_100_50
	bool "FCLK 200 MHz - HCLK 100 MHz - PCLK 50MHz"
	help
	  This setting configures the PLL GCLK frequency to 199.9872 MHz.
	  FCLK is GCLK; HCLK is FCLK/2; PCLK is HCLK/2.  This is the
	  default setting and is known to work reliably on the LPD
	  CardEngines.

config FREQ_200_66_33
	bool "FCLK 200 MHz - HCLK  66 MHz - PCLK 33 MHz"
	help
	  This setting configures the PLL GCLK frequency to 199.9872 MHz.
	  FCLK is GCLK; HCLK is FCLK/3; PCLK is HCLK/2.  This is the
	  default setting for the Trouncer which requires a slow PCLK
	  for the sake of peripherals.

config FREQ_240_120_60
	bool "FCLK 240 MHz - HCLK 120 MHz - PCLK 60 MHz"
	help
	  This setting configures the PLL GCLK frequency to 239.616 MHz.
	  FCLK is GCLK; HCLK is FCLK/2; PCLK is HCLK/2.  This is an
	  overclocking confguration that may be unstable with
	  unqualified parts.

config FREQ_250_125_63
	bool "FCLK 250 MHz - HCLK 125 MHz - PCLK 63 MHz"
	help
	  This setting configures the PLL GCLK frequency to 249.8991 MHz.
	  FCLK is GCLK; HCLK is FCLK/2; PCLK is HCLK/2.  This is an
	  overclocking confguration that may be unstable with
	  unqualified parts.

config FREQ_266_133_66
	bool "FCLK 266 MHz - HCLK 133 MHz - PCLK 66 MHz"
	help
	  This setting configures the PLL GCLK frequency to 265.4218 MHz.
	  FCLK is GCLK; HCLK is FCLK/2; PCLK is HCLK/2.  This is an
	  overclocking confguration that may be unstable with
	  unqualified parts.

config FREQ_100_100_50
	bool "FCLK 100 MHz - HCLK 100 MHz - PCLK 50 MHz"
	help
	  This setting configures the PLL GCLK frequency to 99.9936 MHz.
	  FCLK is GCLK; HCLK is FCLK; PCLK is HCLK/2.  With this
	  setting, the CPU will run in FastBus mode instead of
	  Synchronous mode.

config FREQ_150_75_37
	bool "FCLK 150 MHz - HCLK  75 MHz - PCLK 37 MHz"
	help
	  This setting configures the PLL GCLK frequency to 150.0891 MHz.
	  FCLK is GCLK; HCLK is FCLK/2; PCLK is HCLK/2.

endchoice 

config ATAG_PHYS
	hex "Physical address for ATAGs list"
	default "0xc0000100"
	depends on ATAG
	help
	  This is the address where APEX will construct the ATAG list
	  before starting the Linux kernel.  This address should be
	  within the first 16KiB of physical RAM.  Don't change this
	  value unless you know what you are doing. 

config APEX_VMA
	hex "APEX Runtime Address"
	default "0xc0200000"

config KERNEL_LMA
	hex "Kernel Load Address"
	default "0xc0008000"

config USE_RAMDISK
	bool "Enable ramdisk options"
	default n
	help
	  This option doesn't enable the ramdisk, per se.  It enables
	  other configuration options that help setup a default
	  ramdisk.  The kernel command line and the APEX startup
	  commands may be overridden to perform the same steps.

	  There is a separate option in the Environment section that
	  controls whether or not APEX copies the ramdisk from flash
	  into RAM at startup.  That is where the ramdisk region is
	  defined.

config RAMDISK_LMA
	hex "Ramdisk load address"
	default "0xc4000000"
	depends on USE_RAMDISK
	help
	  This option sets the physical load address for an initial
	  ramdisk (a.k.a initrd).

config RAMDISK_SIZE
	hex "Ramdisk compressed size"
	default "0x00300000"
	depends on USE_RAMDISK
	help
	  This option sets the size, in bytes, of the initial ramdisk
	  (a.k.a. initrd).  This is the size of the compressed initrd
	  image.

config SDRAM_BANK0
	bool "Enable SDRAM Bank 0"
	default y

config SDRAM_BANK1
	bool "Enable SDRAM Bank 1"
	depends on SDRAM_BANK0
	default n 

config SDRAM_CONTIGUOUS
	bool "Initialize SDRAM to be contiguous"
	depends on SDRAM_BANK0
	default y
	help
	  This option initializes the SDRAM controller to map each
	  SDRAM into a contiguous bank, SROMLL.  Normally, SDRAM is
	  sparse in the address space.  Linux does not need this
	  option, but Windows/CE does.  It should be safe to set
	  this option. 

endmenu

menu "Platform Drivers"

config CODEC
	bool "Audio Codec"
	default n
	help
	  This driver includes commands to initialize and test the
	  AC97 link and associated codec.

	  You will not be able to use this code without first creating
	  PCM test data.  It's best to leave this option disabled.

endmenu

config MACH
	string
	default "lh7a40x"

config ARCH_LH7A400
	bool
	select CPU_ARMV4
	select CPU_ARM9
	select CPU_ARM922T

config ARCH_LH7A404
	bool
	select CPU_ARMV4
	select CPU_ARM9
	select CPU_ARM922T

config MACH_LPD7A40X
	bool

endif
```
